## applets/rust/rshello/sdkconfig.defaults
```kconfig
CONFIG_IDF_TARGET_ARCH_XTENSA=y
CONFIG_IDF_TARGET_ARCH="xtensa"
CONFIG_IDF_TARGET="esp32s3"
CONFIG_IDF_TARGET_ESP32S3=y
```

## main/kernel/core/elf/Kconfig.elf
```kconfig
menu "Magnolia ELF Loader"
    config MAGNOLIA_ELF_ENABLED
        bool "Enable kernel ELF loader"
        default y
        help
            Baseline autonomous ELF32 loader integrated with Magnolia jobs.

    config MAGNOLIA_ELF_SELFTESTS
        bool "Run ELF loader selftests at boot"
        depends on MAGNOLIA_ELF_ENABLED
        default n
        help
            Runs basic parsing/relocation tests and optional embedded ELF run.

    config MAGNOLIA_ELF_EXPORT_NEWLIB
        bool "Export extended newlib ABI symbols"
        depends on MAGNOLIA_ELF_ENABLED
        default y
        help
            Exports a larger symbol set (FILE* stdio, newlib _*_r syscalls, scanf family)
            to maximize compatibility with applets built against newlib.

    config MAGNOLIA_ELF_APPLETS_SELFTESTS
        bool "Run ELF applets from LittleFS at boot"
        depends on MAGNOLIA_ELF_ENABLED && MAGNOLIA_LITTLEFS_ENABLED
        default n
        help
            Attempts to run a user ELF applet from the VFS and treats rc=0 as PASS.
            The default path is configured by MAGNOLIA_ELF_SELFTEST_APPLET_PATH.

    config MAGNOLIA_ELF_SELFTEST_APPLET_PATH
        string "ELF selftest applet path"
        depends on MAGNOLIA_ELF_APPLETS_SELFTESTS
        default "/bin/elftest"
        help
            Filesystem path to the ELF applet executed as part of the boot selftests
            when MAGNOLIA_ELF_APPLETS_SELFTESTS is enabled.

    config MAGNOLIA_ELF_AUTOSTART_INIT
        bool "Autostart /bin/init after boot"
        depends on MAGNOLIA_ELF_ENABLED && MAGNOLIA_LITTLEFS_ENABLED && MAGNOLIA_JOB_ENABLED
        default y
        help
            Starts the userland init applet in a dedicated job worker after the kernel
            finishes boot and optional selftests.

    config MAGNOLIA_ELF_INIT_PATH
        string "Init applet path"
        depends on MAGNOLIA_ELF_AUTOSTART_INIT
        default "/bin/init"
        help
            Filesystem path of the init applet started when MAGNOLIA_ELF_AUTOSTART_INIT
            is enabled.

    config MAGNOLIA_ELF_INIT_STACK_DEPTH
        int "Init task stack depth"
        depends on MAGNOLIA_ELF_AUTOSTART_INIT
        range 4096 65536
        default 16384
        help
            Stack reservation for the FreeRTOS task that runs the init job worker,
            specified in BYTES. Increase this if `/bin/init` or applets like `ls`
            trigger FreeRTOS stack overflow detection.
endmenu
```

## main/kernel/core/ipc/Kconfig.ipc
```kconfig
menu "IPC Subsystem"

config MAGNOLIA_IPC_ENABLED
	bool "Enable Magnolia IPC subsystem"
	default y
	help
		Activate the Magnolia IPC runtime that powers signals, channels, event flags,
		waitsets, and shared-memory regions. Disable to reduce flash/RAM when only a
		subset of primitives is needed.

config MAGNOLIA_IPC_DEBUG
	bool "Enable IPC debug instrumentation"
	default n
	depends on MAGNOLIA_IPC_ENABLED
	help
		Toggle verbose tracing, assertions, and telemetry hooks for the IPC layer.
		Useful for debugging but increases code size and runtime overhead.

config MAGNOLIA_IPC_ENABLE_DIAG_DUMP
	bool "Enable IPC diagnostic dumps"
	default n
	depends on MAGNOLIA_IPC_ENABLED
	help
		Expose the Magnolia IPC diagnostic interfaces that read internal state
		into structures and optionally dump matching logs. Disable in space-critical
		builds.

config MAGNOLIA_IPC_SELFTESTS
	bool "Run Magnolia IPC self-tests at boot"
	default n
	depends on MAGNOLIA_IPC_ENABLED
	help
		Execute the Magnolia IPC regression suite during boot to validate signals,
		channels, event flags, shared memory, and waitset interactions.

if MAGNOLIA_IPC_ENABLED
	source "Kconfig.ipc_signal"
	source "Kconfig.ipc_channel"
	source "Kconfig.ipc_event_flags"
	source "Kconfig.ipc_waitset"
	source "Kconfig.ipc_shm"
endif

endmenu
```

## main/kernel/core/ipc/Kconfig.ipc_channel
```kconfig
menu "Message Channels"
	depends on MAGNOLIA_IPC_ENABLED

config MAGNOLIA_IPC_CHANNELS_ENABLED
	bool "Enable IPC message channels"
	default y
	depends on MAGNOLIA_IPC_ENABLED
	help
		Expose bounded FIFO message channels used by producers and consumers
		within Magnolia. Disabling removes transmit/receive helpers.

config MAGNOLIA_IPC_MAX_CHANNELS
	int "Maximum IPC channels"
	range 1 32
	default 4
	depends on MAGNOLIA_IPC_CHANNELS_ENABLED
	help
		Controls how many channel objects can exist simultaneously. Higher values
		allow more concurrent communications at the cost of descriptor tables.

config MAGNOLIA_IPC_CHANNEL_DEFAULT_CAPACITY
	int "Default channel queue depth"
	range 1 32
	default 8
	depends on MAGNOLIA_IPC_CHANNELS_ENABLED
	help
		Default number of pending messages stored in each channel before senders
		block. Larger queues smooth bursts but consume more RAM per channel.

config MAGNOLIA_IPC_CHANNEL_CAPACITY_MAX
	int "Maximum channel queue depth"
	range 1 64
	default 32
	depends on MAGNOLIA_IPC_CHANNELS_ENABLED
	help
		Hard limit enforced by Magnolia when users request channel creation. Keep
		it reasonable relative to available RAM.

config MAGNOLIA_IPC_CHANNEL_DEFAULT_MESSAGE_SIZE
	int "Default channel message size"
	range 1 512
	default 64
	depends on MAGNOLIA_IPC_CHANNELS_ENABLED
	help
		Default payload size used when building helper wrappers or diagnostics
		for channels. Larger messages increase per-channel allocations.

config MAGNOLIA_IPC_CHANNEL_MAX_MESSAGE_SIZE
	int "Maximum channel message size"
	range 1 1024
	default 256
	depends on MAGNOLIA_IPC_CHANNELS_ENABLED
	help
		Upper bound on the message size any channel can carry. This protects from
		overflowing static buffers and keeps per-send allocations bounded.

endmenu
```

## main/kernel/core/ipc/Kconfig.ipc_event_flags
```kconfig
menu "Event Flags"
	depends on MAGNOLIA_IPC_ENABLED

config MAGNOLIA_IPC_EVENT_FLAGS_ENABLED
	bool "Enable IPC event flags"
	default y
	depends on MAGNOLIA_IPC_ENABLED
	help
		Support event flags with masks, wait queues, and waitset notifications.
		Disable to reduce runtime state when only channels or signals are used.

config MAGNOLIA_IPC_MAX_EVENT_FLAGS
	int "Maximum event flag objects"
	range 1 16
	default 8
	depends on MAGNOLIA_IPC_EVENT_FLAGS_ENABLED
	help
		Limits the number of allocated event flag handles Magnolia tracks at
		once. Increasing this value expands the registry arrays.

endmenu
```

## main/kernel/core/ipc/Kconfig.ipc_root
```kconfig
menu "IPC Subsystem (Magnolia)"

config MAGNOLIA_IPC_ENABLED
	bool "Enable Magnolia IPC subsystem"
	default y
	help
		Enable the Magnolia IPC stack (signals, channels, event flags, waitsets,
		and shared memory). Disable to reduce RAM when IPC primitives are unnecessary.

config MAGNOLIA_IPC_DEBUG
	bool "Enable IPC debug logging"
	default n
	depends on MAGNOLIA_IPC_ENABLED
	help
		Turn on verbose logging for IPC primitives. This increases flash/RAM.

config MAGNOLIA_IPC_ENABLE_DIAG_DUMP
	bool "Enable IPC diagnostics export"
	default n
	depends on MAGNOLIA_IPC_ENABLED
	help
		Expose APIs that dump internal IPC object state for debugging.

config MAGNOLIA_IPC_SELFTESTS
	bool "Run IPC self-tests"
	default n
	depends on MAGNOLIA_IPC_ENABLED
	help
		Run the built-in IPC regression suites during boot.

if MAGNOLIA_IPC_ENABLED
	source "../main/kernel/core/ipc/Kconfig.ipc_signal"
	source "../main/kernel/core/ipc/Kconfig.ipc_channel"
	source "../main/kernel/core/ipc/Kconfig.ipc_event_flags"
	source "../main/kernel/core/ipc/Kconfig.ipc_waitset"
	source "../main/kernel/core/ipc/Kconfig.ipc_shm"
endif

endmenu
```

## main/kernel/core/ipc/Kconfig.ipc_shm
```kconfig
menu "Shared Memory"
	depends on MAGNOLIA_IPC_ENABLED

config MAGNOLIA_IPC_SHM_ENABLED
	bool "Enable IPC shared memory"
	default y
	depends on MAGNOLIA_IPC_ENABLED
	help
		Allow Magnolia tasks to create raw, ring buffer, and packet-based shared memory
		regions. Disable to remove the SHM implementation from the build.

config MAGNOLIA_IPC_MAX_SHM_REGIONS
	int "Maximum shared memory regions"
	range 1 16
	default 8
	depends on MAGNOLIA_IPC_SHM_ENABLED
	help
		Controls how many shared memory regions may coexist. Larger values improve
		flexibility but consume registry tables and descriptor state.

config MAGNOLIA_IPC_SHM_DEFAULT_REGION_SIZE
	int "Default shared memory region size"
	range 64 65536
	default 4096
	depends on MAGNOLIA_IPC_SHM_ENABLED
	help
		Default allocation bucket used by helpers covering Magnolia shared memory
		regions when explicit sizes are not provided.

config MAGNOLIA_IPC_SHM_DEFAULT_PACKET_PAYLOAD
	int "Default packet payload size"
	range 64 8192
	default 512
	depends on MAGNOLIA_IPC_SHM_ENABLED
	help
		Default payload capacity used when packet-buffer regions are created.
		Tuned in terms of the expected packet workload.

config MAGNOLIA_IPC_SHM_ALLOW_RING_BUFFER
	bool "Allow ring buffer mode"
	default y
	depends on MAGNOLIA_IPC_SHM_ENABLED
	help
		Enable ring-buffer shared memory regions. Disable to reduce surface area and
		prevent accidental use of the ring buffer semantic.

config MAGNOLIA_IPC_SHM_ALLOW_PACKET_BUFFER
	bool "Allow packet buffer mode"
	default y
	depends on MAGNOLIA_IPC_SHM_ENABLED
	help
		Enable packet-buffer shared memory regions that store discrete payloads.
		Disable when only raw/ring buffers should be used.

endmenu
```

## main/kernel/core/ipc/Kconfig.ipc_signal
```kconfig
menu "Signals"
	depends on MAGNOLIA_IPC_ENABLED

config MAGNOLIA_IPC_SIGNALS_ENABLED
	bool "Enable IPC signals"
	default y
	depends on MAGNOLIA_IPC_ENABLED
	help
		Provide counting and one-shot signal objects backed by wait queues.
		Disabling removes the signal primitive and related waitset support.

config MAGNOLIA_IPC_MAX_SIGNALS
	int "Maximum signal objects"
	range 1 32
	default 8
	depends on MAGNOLIA_IPC_SIGNALS_ENABLED
	help
		Upper bound on the number of simultaneously allocated signal handles
		Magnolia allows. Raising this improves scalability but increases registry
		memory and waitset tracking overhead.

config MAGNOLIA_IPC_SIGNAL_DIAGNOSTIC_VERBOSITY
	int "Signal diagnostic verbosity"
	range 0 3
	default 0
	depends on MAGNOLIA_IPC_SIGNALS_ENABLED
	help
		Advanced option. Higher values emit more diagnostics during signal
		state transitions. Useful for debugging waitset latency and timing issues.

endmenu
```

## main/kernel/core/ipc/Kconfig.ipc_waitset
```kconfig
menu "WaitSets"
	depends on MAGNOLIA_IPC_ENABLED

config MAGNOLIA_IPC_WAITSET_ENABLED
	bool "Enable IPC waitsets"
	default y
	depends on MAGNOLIA_IPC_ENABLED
	help
		Expose the Magnolia waitset notifications used by signals and event
		flags. Disable this to drive only blocking waits in combination with the
		existing primitives.

config MAGNOLIA_IPC_WAITSET_MAX_ENTRIES
	int "Maximum waitset listeners"
	range 1 32
	default 8
	depends on MAGNOLIA_IPC_WAITSET_ENABLED
	help
		Maximum number of waitset listeners that can be attached to a single IPC
		primitive at once. Raising this protects waitset usage in high fan-out
		scenarios.

endmenu
```
