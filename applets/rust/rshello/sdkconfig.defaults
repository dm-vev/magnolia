## main/kernel/core/vfs/Kconfig.vfs
```kconfig
menu "Magnolia Virtual Filesystem"

config MAGNOLIA_VFS_ENABLED
    bool "Enable Magnolia VFS"
    default y
    depends on MAGNOLIA_JOB_ENABLED
    help
        Build the Magnolia virtual filesystem core that coordinates filesystem
        drivers, per-job FD tables, and path resolution. The job subsystem must
        be enabled because FD tables and diagnostics attach to job lifecycles.

config MAGNOLIA_VFS_NODE_LIFETIME_CHECK
    bool "Enable VFS node lifetime diagnostics"
    default n
    depends on MAGNOLIA_VFS_ENABLED
    help
        Track and report vnode reference-count anomalies such as double-free,
        late releases, or leaked nodes. This lights up additional instrumentation
        useful during development, but adds logging and a small atomic counter
        to the VFS core.

config MAGNOLIA_VFS_MAX_FS_TYPES
    int "Maximum filesystem types"
    range 1 16
    default 8
    depends on MAGNOLIA_VFS_ENABLED
    help
        How many filesystem drivers may register with the VFS. Keep this small
        while the stack is under development and grow it later when more
        drivers are added.

config MAGNOLIA_VFS_MAX_MOUNTS
    int "Maximum mountpoints"
    range 1 16
    default 8
    depends on MAGNOLIA_VFS_ENABLED
    help
        Cap on simultaneously mounted filesystems tracked by the Magnolia VFS
        registry. Increasing this consumes more bookkeeping RAM, so keep it
        tight until mounted filesystems are actually used.

config MAGNOLIA_VFS_MOUNT_OVERLAYS
    bool "Allow mount overlays"
    default y
    depends on MAGNOLIA_VFS_ENABLED
    help
        Permit multiple filesystems to be mounted at the same mountpoint.
        New mounts shadow older ones, enabling overlay and layered filesystem
        setups that are resolved by the VFS resolver.

config MAGNOLIA_VFS_MAX_OPEN_FILES_PER_JOB
    int "Max open files per job"
    range 4 64
    default 16
    depends on MAGNOLIA_VFS_ENABLED
    help
        Limits the number of FDs a Magnolia job may open at once. Sets the size
        of the job-local FD table and bounds per-job memory usage.
        Note: file descriptors 0/1/2 are reserved for stdin/stdout/stderr.

config MAGNOLIA_VFS_MAX_OPEN_FILES_GLOBAL
    int "Kernel-global FD capacity"
    range 4 64
    default 16
    depends on MAGNOLIA_VFS_ENABLED
    help
        Maximum number of global FDs that kernel contexts may take (job is
        NULL). This guards the kernel FD table used for drivers that operate
        outside of job contexts.
        Note: file descriptors 0/1/2 are reserved for stdin/stdout/stderr.

config MAGNOLIA_VFS_FD_LOGGING
    bool "Enable VFS FD table logging"
    default n
    depends on MAGNOLIA_VFS_ENABLED
    help
        Log job/kernel FD allocations, releases, and explicit assignments for
        stronger diagnostics during debugging runs. This pulls in the ESP log
        subsystem and should only be used in traced configurations.

config MAGNOLIA_VFS_DEVFS
    bool "Enable DevFS device filesystem"
    default y
    depends on MAGNOLIA_VFS_ENABLED
    help
        Mount the virtual /dev filesystem so device drivers can register
        device nodes through the unified VFS driver model. All IO travels
        through VFS → DevFS → device_ops with no filesystem-specific logic
        embedded directly in the VFS core.

config MAGNOLIA_DEVFS_MAX_DEVICES
    int "Maximum DevFS devices"
    range 1 64
    default 16
    depends on MAGNOLIA_VFS_DEVFS
    help
        Cap the number of device nodes that may simultaneously exist in DevFS.
        Once this limit is reached, devfs_register rejects further devices until
        others are unregistered.

config MAGNOLIA_DEVFS_SELFTESTS
    bool "Enable DevFS self-tests"
    default n
    depends on MAGNOLIA_VFS_DEVFS
    help
        Build the DevFS self-tests that mount /dev, check /dev/null, /dev/zero,
        /dev/random, and validate basic open/read/write/readdir paths through
        the Magnolia VFS.

config MAGNOLIA_VFS_MAX_PATH_LEN
    int "Maximum path length"
    range 32 1024
    default 256
    depends on MAGNOLIA_VFS_ENABLED
    help
        Upper bound on path buffer lengths allocated by the VFS path helpers.
        Larger values allow longer paths but increase stack/heap usage in
        normalization helpers.

config MAGNOLIA_RAMFS_ENABLED
    bool "Enable RAMFS reference filesystem"
    default y
    depends on MAGNOLIA_VFS_ENABLED
    help
        Mount Magnolia's in-memory RAMFS implementation that acts as the first
        reference filesystem for the virtual filesystem core.

config MAGNOLIA_RAMFS_MAX_NODES
    int "Maximum RAMFS nodes"
    range 16 1024
    default 256
    depends on MAGNOLIA_RAMFS_ENABLED
    help
        Cap the number of RAMFS nodes (files + directories) that can coexist.
        Once this limit is reached, RAMFS rejects new creates until nodes are
        deleted.

config MAGNOLIA_VFS_FORCE_UNMOUNT
    bool "Enable forced unmount API"
    default y
    depends on MAGNOLIA_VFS_ENABLED
    help
        Allow the kernel to forcibly tear down mountpoints even if there are
        dangling nodes. This should only be enabled for recovery tooling or
        debug builds because it can break driver assumptions about node
        lifetimes.

config MAGNOLIA_VFS_READ_CACHE
    bool "Enable read cache for VFS"
    default y
    depends on MAGNOLIA_VFS_ENABLED
    help
        Cache read() blocks in the VFS core so repeated small reads from device
        files do not re-hit the drivers. The cache transparently buffers fixed-
        size blocks, maintains an LRU eviction order, and can be flushed through
        diagnostics. RAMFS bypasses the cache because it already lives in RAM.

config MAGNOLIA_VFS_READ_CACHE_SIZE
    int "Read cache block count"
    range 1 64
    default 8
    depends on MAGNOLIA_VFS_READ_CACHE
    help
        Number of blocks retained by the read cache. Each block is 512 bytes,
        so increasing this value raises the total cache footprint. Clearing the
        cache flushes all blocks and updates the hit/miss diagnostics.

config MAGNOLIA_VFS_SELFTESTS
    bool "Enable VFS regression self-tests"
    default n
    depends on MAGNOLIA_VFS_ENABLED
    help
        Run the Magnolia VFS regression suite (resolver edge cases, errno
        counters, read-cache stats, FD/dup semantics, metadata coverage) during
        initialization so the core is sanity-checked before real workloads.

config MAGNOLIA_VFS_STRESS_TESTS
    bool "Enable VFS/DevFS stress tests"
    default n
    depends on MAGNOLIA_VFS_ENABLED
    help
        Run higher-load stress tests for the VFS/DevFS IPC path (close races,
        poll under teardown, error-injection smoke). These tests are intended
        for development and bring-up; disable in production builds.

config MAGNOLIA_LITTLEFS_ENABLED
    bool "Enable LittleFS driver"
    default y
    depends on MAGNOLIA_VFS_ENABLED
    help
        Include Magnolia's LittleFS adapter so a flash partition can be mounted
        through the Magnolia VFS. The driver uses ESP-IDF esp_partition APIs as
        the backing block device.

config MAGNOLIA_LITTLEFS_PARTITION_LABEL
    string "LittleFS partition label"
    default "vfs"
    depends on MAGNOLIA_LITTLEFS_ENABLED
    help
        Label of the data partition that LittleFS should mount. The partition
        must exist in partitions.csv.

config MAGNOLIA_LITTLEFS_FORMAT_IF_FAIL
    bool "Format partition if mount fails"
    default y
    depends on MAGNOLIA_LITTLEFS_ENABLED
    help
        If enabled and the mount fails due to an empty or corrupt filesystem,
        the driver will format the partition and retry the mount.

config MAGNOLIA_LITTLEFS_BLOCK_SIZE
    int "Logical block size"
    range 256 4096
    default 4096
    depends on MAGNOLIA_LITTLEFS_ENABLED
    help
        Size of a logical block that LittleFS will manage. Must divide the
        actual flash erase size and is used for calculating the total storage
        footprint.

config MAGNOLIA_LITTLEFS_BLOCK_COUNT
    int "Block count"
    range 8 2048
    default 128
    depends on MAGNOLIA_LITTLEFS_ENABLED
    help
        Total number of erasable blocks exposed to LittleFS. Combined with the
        block size this defines how much backing storage an instance consumes.

config MAGNOLIA_LITTLEFS_READ_SIZE
    int "Read size"
    range 16 512
    default 128
    depends on MAGNOLIA_LITTLEFS_ENABLED

config MAGNOLIA_LITTLEFS_PROG_SIZE
    int "Program size"
    range 16 512
    default 128
    depends on MAGNOLIA_LITTLEFS_ENABLED

config MAGNOLIA_LITTLEFS_CACHE_SIZE
    int "Cache size"
    range 64 2048
    default 512
    depends on MAGNOLIA_LITTLEFS_ENABLED

config MAGNOLIA_LITTLEFS_LOOKAHEAD_SIZE
    int "Lookahead buffer size"
    range 8 256
    default 64
    depends on MAGNOLIA_LITTLEFS_ENABLED

config MAGNOLIA_LITTLEFS_BLOCK_CYCLES
    int "Block cycles"
    range -1 2000
    default 128
    depends on MAGNOLIA_LITTLEFS_ENABLED
    help
        Number of erase cycles before LittleFS evicts metadata to achieve
        wear-leveling. Set to -1 to disable wear-leveling.

config MAGNOLIA_LITTLEFS_ERASE_BLOCKS
    int "Erase blocks per operation"
    range 1 16
    default 1
    depends on MAGNOLIA_LITTLEFS_ENABLED
    help
        Kept for compatibility with the old RAM backend. The flash backend
        erases exactly one logical block per erase callback.

config MAGNOLIA_LITTLEFS_LOCK_TIMEOUT_MS
    int "LittleFS lock timeout (ms)"
    range 10 60000
    default 2000
    depends on MAGNOLIA_LITTLEFS_ENABLED
    help
        Maximum time a VFS operation will wait to acquire the filesystem lock
        before returning M_VFS_ERR_TIMEOUT.

config MAGNOLIA_VFS_LITTLEFS_SELFTESTS
    bool "Enable LittleFS selftests"
    default n
    depends on MAGNOLIA_LITTLEFS_ENABLED
    help
        Build the LittleFS self-tests that exercise mounting, formatting, and
        IO operations through the Magnolia VFS layer.

config MAGNOLIA_LITTLEFS_SELFTEST_TASK_STACK_DEPTH
    int "LittleFS selftests task stack depth"
    default 4096
    depends on MAGNOLIA_VFS_LITTLEFS_SELFTESTS
    help
        Stack depth (in FreeRTOS words, like xTaskCreate) used to run the LittleFS
        selftests in a dedicated task to avoid overflowing the main task stack.

config MAGNOLIA_LITTLEFS_TEST_LOG_IO
    bool "Log LittleFS flash IO during selftests"
    default y
    depends on MAGNOLIA_VFS_LITTLEFS_SELFTESTS
    help
        When enabled, the LittleFS flash backend logs every read/program/erase
        callback with block numbers and absolute addresses. Intended for bring-up.

config MAGNOLIA_LITTLEFS_TEST_DESTRUCTIVE
    bool "Allow destructive LittleFS selftests"
    default y
    depends on MAGNOLIA_VFS_LITTLEFS_SELFTESTS
    help
        Selftests may erase/write the first erase block and force-format the
        partition. Disable for production devices with valuable data.

config MAGNOLIA_LITTLEFS_TEST_WEAR_CYCLES
    int "Wear test cycles"
    range 10 100000
    default 200
    depends on MAGNOLIA_VFS_LITTLEFS_SELFTESTS
    help
        Number of create/write/delete cycles to run in the wear test phase.

config MAGNOLIA_LITTLEFS_TEST_POWERLOSS
    bool "Enable power-loss reboot simulation"
    default n
    depends on MAGNOLIA_VFS_LITTLEFS_SELFTESTS
    help
        If enabled, the power-loss test will trigger esp_restart() mid-write and
        validate consistency on next boot using a marker file.

endmenu
```

## sdkconfig.defaults
```kconfig
CONFIG_ESP_SYSTEM_MEMPROT_FEATURE=n
CONFIG_FREERTOS_UNICORE=y
CONFIG_MAGNOLIA_SCHED_SELFTESTS=n
CONFIG_MAGNOLIA_JOB_SELFTESTS=n
CONFIG_MAGNOLIA_ALLOC_SELFTESTS=n
# Ensure IPC SHM can provide enough regions for DevFS streaming devices.
CONFIG_MAGNOLIA_IPC_MAX_SHM_REGIONS=16
# Leave headroom for runtime/devfs self-test registrations.
CONFIG_MAGNOLIA_DEVFS_MAX_DEVICES=24

# Userland ELF (init + applets) needs more stack than ESP-IDF defaults.
CONFIG_MAGNOLIA_JOB_WORKER_STACK_DEPTH=8192
CONFIG_MAGNOLIA_ELF_INIT_STACK_DEPTH=65536
```
