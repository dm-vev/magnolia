## main/Kconfig.projbuild
```kconfig
menu "MagnoliaOS Configuration"
    config MAGNOLIA_KERNEL_ROOT_PROC_PRIO
        int "Root process priority"
        range 4 32
        default 8
        help
            Приоритет корневого процесса в системе.

source "$IDF_PATH/../main/kernel/core/sched/Kconfig.sched"
source "$IDF_PATH/../main/kernel/core/timer/Kconfig.timer"
source "$IDF_PATH/../main/kernel/core/memory/Kconfig.memory"
source "$IDF_PATH/../main/kernel/core/net/Kconfig.net"

source "$IDF_PATH/../main/kernel/core/elf/Kconfig.elf"
source "$IDF_PATH/../main/kernel/core/job/Kconfig.job"
source "$IDF_PATH/../main/kernel/core/vfs/Kconfig.vfs"
source "$IDF_PATH/../main/kernel/vfs/fs/devfs/Kconfig.devfs"
source "$IDF_PATH/../main/kernel/core/ipc/Kconfig.ipc_root"

endmenu
```

## main/kernel/core/net/Kconfig.net
```kconfig
menu "Magnolia Network"

config MAGNOLIA_NET_ENABLE
    bool "Enable Magnolia network stack"
    default n
    depends on MAGNOLIA_JOB_ENABLED
    help
        Enable Magnolia network core with a single netdev backed by ESP-IDF.

config MAGNOLIA_NET_BACKEND_LWIP
    bool "Use ESP-IDF lwIP backend"
    default y
    depends on MAGNOLIA_NET_ENABLE
    help
        Use ESP-IDF's lwIP stack for IPv4/TCP/UDP functionality.

config MAGNOLIA_NET_USE_ETH
    bool "Enable Ethernet netdev"
    default y
    depends on MAGNOLIA_NET_ENABLE
    help
        Bring up Ethernet using esp_eth and esp_netif glue.

config MAGNOLIA_NET_USE_WIFI
    bool "Enable Wi-Fi netdev"
    default n
    depends on MAGNOLIA_NET_ENABLE && ESP_WIFI_ENABLED
    help
        Bring up Wi-Fi STA mode using esp_wifi and esp_netif glue.

config MAGNOLIA_NET_WIFI_SSID
    string "Wi-Fi SSID"
    default ""
    depends on MAGNOLIA_NET_USE_WIFI
    help
        SSID for Wi-Fi STA connection. Leave empty to disable Wi-Fi bring-up.

config MAGNOLIA_NET_WIFI_PASSWORD
    string "Wi-Fi password"
    default ""
    depends on MAGNOLIA_NET_USE_WIFI
    help
        Password for Wi-Fi STA connection.

config MAGNOLIA_NET_DHCP
    bool "Use DHCP"
    default y
    depends on MAGNOLIA_NET_ENABLE
    help
        Use DHCP to obtain IPv4 configuration for the default netdev.

config MAGNOLIA_NET_STATIC_IP
    string "Static IPv4 address"
    default ""
    depends on MAGNOLIA_NET_ENABLE
    help
        Static IPv4 address (e.g. 192.168.1.50). Used when DHCP is disabled.

config MAGNOLIA_NET_STATIC_MASK
    string "Static IPv4 netmask"
    default ""
    depends on MAGNOLIA_NET_ENABLE
    help
        Static IPv4 netmask (e.g. 255.255.255.0). Used when DHCP is disabled.

config MAGNOLIA_NET_STATIC_GW
    string "Static IPv4 gateway"
    default ""
    depends on MAGNOLIA_NET_ENABLE
    help
        Static IPv4 gateway (e.g. 192.168.1.1). Used when DHCP is disabled.

config MAGNOLIA_NET_LOG_LEVEL
    int "Network log level"
    range 0 5
    default 3
    depends on MAGNOLIA_NET_ENABLE
    help
        ESP_LOG level for the Magnolia network subsystem (0=NONE..5=VERBOSE).

config MAGNOLIA_NETD_STACK_DEPTH
    int "netd job stack depth"
    range 2048 65536
    default 4096
    depends on MAGNOLIA_NET_ENABLE
    help
        Stack depth for the netd job worker.

endmenu
```

## main/kernel/vfs/fs/devfs/Kconfig.devfs
```kconfig
menu "DevFS streaming devices"

config MAGNOLIA_DEVFS_GPIO
    bool "Enable DevFS GPIO device"
    default y
    depends on MAGNOLIA_VFS_DEVFS
    help
        Build /dev/gpio device node for GPIO control and edge events.

config MAGNOLIA_DEVFS_GPIO_EVENT_QUEUE_LEN
    int "GPIO event queue length"
    range 8 256
    default 32
    depends on MAGNOLIA_DEVFS_GPIO
    help
        Maximum number of queued GPIO edge events.

config MAGNOLIA_DEVFS_PIPES
    bool "Enable DevFS pipe devices"
    default y
    depends on MAGNOLIA_VFS_DEVFS
    help
        Build the /dev/pipeX family that exposes unidirectional FIFO streams
        backed by shared memory and scheduler wait/wake mechanisms.

config MAGNOLIA_DEVFS_KMSG
    bool "Enable /dev/kmsg log device"
    default y
    depends on MAGNOLIA_VFS_DEVFS && MAGNOLIA_IPC_ENABLED
    help
        Build /dev/kmsg for reading kernel log output from userland.

config MAGNOLIA_DEVFS_KMSG_BUFFER_SIZE
    int "Kernel log buffer size"
    range 256 65536
    default 4096
    depends on MAGNOLIA_DEVFS_KMSG
    help
        Size of the shared ring buffer used for kernel log retention.

config MAGNOLIA_DEVFS_PIPE_COUNT
    int "Number of pipe instances"
    range 1 16
    default 4
    depends on MAGNOLIA_DEVFS_PIPES
    help
        Maximum number of /dev/pipeX nodes that may be registered at once.

config MAGNOLIA_DEVFS_TTY
    bool "Enable DevFS TTY devices"
    default y
    depends on MAGNOLIA_VFS_DEVFS
    help
        Build the /dev/ttyX nodes that layer canonical/raw line discipline on top
        of the SHM streaming backend.

config MAGNOLIA_DEVFS_TTY_COUNT
    int "TTY count"
    range 1 8
    default 2
    depends on MAGNOLIA_DEVFS_TTY
    help
        Controls how many /dev/ttyX nodes are created.

config MAGNOLIA_DEVFS_TTY_LINE_BUFFER_SIZE
    int "TTY line buffer length"
    range 32 1024
    default 256
    depends on MAGNOLIA_DEVFS_TTY
    help
        Length of the canonical mode line buffer used for editing input before
        dispatching complete lines.

config MAGNOLIA_DEVFS_TTY_ECHO
    bool "Default TTY echo mode"
    default y
    depends on MAGNOLIA_DEVFS_TTY

config MAGNOLIA_DEVFS_TTY_CANON
    bool "Default TTY canonical mode"
    default y
    depends on MAGNOLIA_DEVFS_TTY

config MAGNOLIA_DEVFS_TTY_DEBUG
    bool "Enable TTY debug diagnostics"
    default n
    depends on MAGNOLIA_DEVFS_TTY

config MAGNOLIA_DEVFS_PTY
    bool "Enable DevFS pseudo-terminals"
    default y
    depends on MAGNOLIA_VFS_DEVFS
    help
        Build /dev/pty/masterX and /dev/pty/slaveX pairs that expose
        bidirectional streaming between masters and slaves.

config MAGNOLIA_DEVFS_PTY_COUNT
    int "PTY pair count"
    range 1 8
    default 3
    depends on MAGNOLIA_DEVFS_PTY
    help
        Maximum number of pseudo-terminal pairs (master + slave) that can be allocated.

config MAGNOLIA_DEVFS_SHM_BUFFER_SIZE
    int "DevFS streaming buffer size"
    range 64 16384
    default 512
    depends on MAGNOLIA_VFS_DEVFS
    help
        Size of the shared ring buffer used by pipes, TTY, and PTY devices.

menu "Allocator devices"

config MAGNOLIA_DEVFS_ALLOC
    bool "Enable DevFS allocator control"
    default y
    depends on MAGNOLIA_VFS_DEVFS && MAGNOLIA_ALLOC_ENABLED
    help
        Build /dev/alloc for runtime job heap limit control.

endmenu

menu "Framebuffer devices"

config MAGNOLIA_DEVFS_FB
    bool "Enable DevFS framebuffer device"
    default n
    depends on MAGNOLIA_VFS_DEVFS
    help
        Build /dev/fb0 device node for RGB565 framebuffer output.

choice MAGNOLIA_FB_BACKEND
    prompt "Framebuffer backend"
    default MAGNOLIA_FB_BACKEND_SPI_ST7786
    depends on MAGNOLIA_DEVFS_FB

config MAGNOLIA_FB_BACKEND_QEMU
    bool "QEMU RGB panel"

config MAGNOLIA_FB_BACKEND_SPI_ST7786
    bool "SPI ST7786 panel (RGB565)"

endchoice

config MAGNOLIA_FB_WIDTH
    int "Framebuffer width"
    range 1 2048
    default 320
    depends on MAGNOLIA_DEVFS_FB

config MAGNOLIA_FB_HEIGHT
    int "Framebuffer height"
    range 1 2048
    default 240
    depends on MAGNOLIA_DEVFS_FB

config MAGNOLIA_FB_BGR
    bool "Use BGR color order"
    default n
    depends on MAGNOLIA_DEVFS_FB

config MAGNOLIA_FB_INVERT_COLOR
    bool "Invert panel colors"
    default n
    depends on MAGNOLIA_FB_BACKEND_SPI_ST7786

config MAGNOLIA_FB_SWAP_XY
    bool "Swap X and Y axes"
    default n
    depends on MAGNOLIA_FB_BACKEND_SPI_ST7786

config MAGNOLIA_FB_MIRROR_X
    bool "Mirror X axis"
    default n
    depends on MAGNOLIA_FB_BACKEND_SPI_ST7786

config MAGNOLIA_FB_MIRROR_Y
    bool "Mirror Y axis"
    default n
    depends on MAGNOLIA_FB_BACKEND_SPI_ST7786

config MAGNOLIA_FB_X_OFFSET
    int "X offset"
    range -255 255
    default 0
    depends on MAGNOLIA_FB_BACKEND_SPI_ST7786

config MAGNOLIA_FB_Y_OFFSET
    int "Y offset"
    range -255 255
    default 0
    depends on MAGNOLIA_FB_BACKEND_SPI_ST7786

config MAGNOLIA_FB_RESET_ACTIVE_HIGH
    bool "Reset pin active high"
    default n
    depends on MAGNOLIA_FB_BACKEND_SPI_ST7786

config MAGNOLIA_FB_SPI_HOST
    int "SPI host (2 or 3)"
    range 2 3
    default 2
    depends on MAGNOLIA_FB_BACKEND_SPI_ST7786

config MAGNOLIA_FB_SPI_PCLK_HZ
    int "SPI pixel clock (Hz)"
    range 1000000 80000000
    default 40000000
    depends on MAGNOLIA_FB_BACKEND_SPI_ST7786

config MAGNOLIA_FB_SPI_QUEUE_DEPTH
    int "SPI transaction queue depth"
    range 1 16
    default 10
    depends on MAGNOLIA_FB_BACKEND_SPI_ST7786

config MAGNOLIA_FB_SPI_MOSI
    int "SPI MOSI GPIO"
    range -1 48
    default -1
    depends on MAGNOLIA_FB_BACKEND_SPI_ST7786

config MAGNOLIA_FB_SPI_SCLK
    int "SPI SCLK GPIO"
    range -1 48
    default -1
    depends on MAGNOLIA_FB_BACKEND_SPI_ST7786

config MAGNOLIA_FB_SPI_CS
    int "SPI CS GPIO"
    range -1 48
    default -1
    depends on MAGNOLIA_FB_BACKEND_SPI_ST7786

config MAGNOLIA_FB_SPI_DC
    int "SPI DC GPIO"
    range -1 48
    default -1
    depends on MAGNOLIA_FB_BACKEND_SPI_ST7786

config MAGNOLIA_FB_SPI_RST
    int "SPI reset GPIO"
    range -1 48
    default -1
    depends on MAGNOLIA_FB_BACKEND_SPI_ST7786

config MAGNOLIA_FB_BACKLIGHT_GPIO
    int "Backlight GPIO"
    range -1 48
    default -1
    depends on MAGNOLIA_FB_BACKEND_SPI_ST7786

endmenu

endmenu
```

## sdkconfig.defaults.esp32
```kconfig
# Defaults for ESP32 target.
CONFIG_MAGNOLIA_ALLOC_SELFTESTS=n
CONFIG_MAGNOLIA_ALLOC_REGION_SIZE=65536
CONFIG_MAGNOLIA_ALLOC_MAX_REGIONS_PER_JOB=64
CONFIG_MAGNOLIA_ALLOC_MAX_HEAP_SIZE_PER_JOB=0
CONFIG_MAGNOLIA_ALLOC_JOB_HEAP_DEFAULT_PERCENT=50
CONFIG_SPIRAM=y
CONFIG_SPIRAM_USE_MALLOC=y
CONFIG_SPIRAM_IGNORE_NOTFOUND=y
CONFIG_ELF_LOADER_LOAD_PSRAM=y
CONFIG_ESP_EVENT_POST_FROM_IRAM_ISR=n
CONFIG_ESP_SPI_BUS_LOCK_ISR_FUNCS_IN_IRAM=n
CONFIG_ESP_INTR_IN_IRAM=n
CONFIG_ESP_PHY_IRAM_OPT=n
CONFIG_PM_SLEEP_FUNC_IN_IRAM=n
CONFIG_PM_SLP_IRAM_OPT=n
CONFIG_ESP_ROM_PRINT_IN_IRAM=n
CONFIG_ESP_SYSTEM_IN_IRAM=n
CONFIG_ESP_TIMER_IN_IRAM=n
CONFIG_ESP_WIFI_IRAM_OPT=n
CONFIG_ESP_WIFI_RX_IRAM_OPT=n
CONFIG_LOG_IN_IRAM=n
CONFIG_LIBC_MISC_IN_IRAM=n
CONFIG_LIBC_LOCKS_PLACE_IN_IRAM=n
CONFIG_SPI_FLASH_PLACE_FUNCTIONS_IN_IRAM=n
CONFIG_MAGNOLIA_LITTLEFS_BLOCK_COUNT=512
```
